## base_external/package/ldd/Config.in
```kconfig
config BR2_PACKAGE_AESD_LDD
	bool "ldd"
	help
	  Supports building and installing the misc-modules and scull components
	  into the root filesystem in the kernel image.
```
